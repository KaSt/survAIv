## atoms3/sdkconfig.defaults
```kconfig
CONFIG_IDF_TARGET="esp32s3"
CONFIG_SPIRAM=y
CONFIG_SPIRAM_MODE_OCT=y
CONFIG_ESP_TLS_USING_MBEDTLS=y
CONFIG_MBEDTLS_CERTIFICATE_BUNDLE=y
CONFIG_MBEDTLS_CERTIFICATE_BUNDLE_DEFAULT_FULL=y
CONFIG_PARTITION_TABLE_CUSTOM=y
CONFIG_PARTITION_TABLE_CUSTOM_FILENAME="partitions.csv"
CONFIG_ESPTOOLPY_FLASHSIZE_8MB=y
CONFIG_ESP_MAIN_TASK_STACK_SIZE=16384
CONFIG_LWIP_DNS_SUPPORT_MDNS_QUERIES=y
CONFIG_SURVAIV_HAS_DISPLAY=y
CONFIG_SURVAIV_DISPLAY_GC9107_ATOMS3=y
CONFIG_SURVAIV_SCREEN_TIMEOUT_SEC=30
CONFIG_SURVAIV_MARKET_LIMIT=12
CONFIG_LWIP_MAX_SOCKETS=16
```

## c3oled/sdkconfig.defaults
```kconfig
# ESP32-C3 SuperMini with 0.42" SSD1306 OLED
CONFIG_IDF_TARGET="esp32c3"

# TLS + certs
CONFIG_ESP_TLS_USING_MBEDTLS=y
CONFIG_MBEDTLS_CERTIFICATE_BUNDLE=y
CONFIG_MBEDTLS_CERTIFICATE_BUNDLE_DEFAULT_FULL=y

# Flash — 4 MB, custom partition table
CONFIG_ESPTOOLPY_FLASHSIZE_4MB=y
CONFIG_PARTITION_TABLE_CUSTOM=y
CONFIG_PARTITION_TABLE_CUSTOM_FILENAME="partitions.csv"

# Stack
CONFIG_ESP_MAIN_TASK_STACK_SIZE=16384

# OTA enabled
CONFIG_SURVAIV_ENABLE_OTA=y

# Display — SSD1306 OLED via I2C
CONFIG_SURVAIV_HAS_DISPLAY=y
CONFIG_SURVAIV_DISPLAY_SSD1306_C3OLED=y
CONFIG_SURVAIV_SCREEN_TIMEOUT_SEC=30
CONFIG_SURVAIV_MARKET_LIMIT=6
```

## main/Kconfig.projbuild
```kconfig
menu "Survaiv Agent"

config SURVAIV_ENABLE_OTA
    bool "Enable OTA (over-the-air) updates"
    default y
    help
        When enabled, the partition table uses two OTA app slots (~1.75 MB each
        on a 4 MB flash). Disabling OTA uses a single factory partition (~3.9 MB),
        giving the app much more flash space and allowing higher resource limits.
        Without OTA you must flash via USB cable.

config SURVAIV_WIFI_SSID
    string "Wi-Fi SSID"
    default ""

config SURVAIV_WIFI_PASSWORD
    string "Wi-Fi password"
    default ""

config SURVAIV_OPENAI_BASE_URL
    string "OpenAI-compatible base URL"
    default "https://devnet.aimo.network/api/v1"

config SURVAIV_OPENAI_MODEL
    string "Model name"
    default "openai/gpt-4o"

config SURVAIV_API_KEY
    string "Managed x402 API key"
    default ""

config SURVAIV_PAPER_TRADING_ONLY
    bool "Paper trading only"
    default y

config SURVAIV_LOOP_SECONDS
    int "Seconds between agent cycles"
    range 60 86400
    default 900

config SURVAIV_STARTING_BANKROLL_CENTS
    int "Starting bankroll in USDC cents"
    range 100 10000000
    default 2500

config SURVAIV_RESERVE_CENTS
    int "Minimum cash reserve in USDC cents"
    range 0 10000000
    default 500

config SURVAIV_MAX_OPEN_POSITIONS
    int "Maximum paper positions"
    range 0 16
    default 3

config SURVAIV_MARKET_LIMIT
    int "Top markets per scan"
    range 1 50
    default 6

config SURVAIV_MAX_TOOL_CALLS_PER_CYCLE
    int "Maximum tool calls per agent cycle"
    range 0 4
    default 1

config SURVAIV_NEWS_API_KEY
    string "News search API key (Tavily or Brave)"
    default ""
    help
        API key for web search. Tavily: tvly-xxx, Brave: BSA-xxx.

config SURVAIV_EST_PROMPT_TOKENS
    int "Estimated prompt tokens per LLM call"
    range 64 32768
    default 1800

config SURVAIV_EST_COMPLETION_TOKENS
    int "Estimated completion tokens per LLM call"
    range 16 8192
    default 300

config SURVAIV_INPUT_PRICE_MICROUSDC_PER_1M
    int "Input token price in micro-USDC per 1M tokens"
    range 1 1000000000
    default 150000

config SURVAIV_OUTPUT_PRICE_MICROUSDC_PER_1M
    int "Output token price in micro-USDC per 1M tokens"
    range 1 1000000000
    default 600000

config SURVAIV_MAX_POSITION_BPS
    int "Maximum paper position size in basis points of equity"
    range 1 10000
    default 200

menu "Live Trading (CLOB)"

config SURVAIV_WALLET_PRIVATE_KEY
    string "Wallet private key (hex, 64 chars)"
    default ""
    help
        Hex-encoded 32-byte secp256k1 private key for Polygon wallet.
        Used for EIP-712 order signing and CLOB authentication.
        Leave empty to disable live trading even if paper_trading_only is off.

config SURVAIV_POLYGON_RPC_URL
    string "Polygon JSON-RPC URL"
    default "https://polygon-rpc.com"

config SURVAIV_CLOB_BASE_URL
    string "Polymarket CLOB base URL"
    default "https://clob.polymarket.com"

config SURVAIV_DAILY_LOSS_LIMIT_CENTS
    int "Daily loss limit in USDC cents"
    range 10 10000000
    default 500
    help
        Agent refuses new live trades once cumulative daily realized loss
        exceeds this amount. Reset each calendar day (UTC).

config SURVAIV_LIVE_CONFIDENCE_THRESHOLD
    int "Minimum confidence for live trades (percent)"
    range 50 99
    default 75

config SURVAIV_LIVE_MIN_EDGE_BPS
    int "Minimum edge for live trades (basis points)"
    range 50 5000
    default 200

config SURVAIV_COOLDOWN_AFTER_LOSS_SECONDS
    int "Cooldown after a losing trade (seconds)"
    range 0 86400
    default 1800

endmenu

menu "On-board Display"

config SURVAIV_HAS_DISPLAY
    bool "Board has built-in display"
    default n
    help
        Enable LCD display support for boards with built-in screens.
        Requires the screen component in EXTRA_COMPONENT_DIRS.

choice SURVAIV_DISPLAY_TYPE
    prompt "Display controller and board"
    depends on SURVAIV_HAS_DISPLAY

config SURVAIV_DISPLAY_GC9107_TQT
    bool "LilyGO T-QT Pro (128x128 GC9107)"
    help
        0.85 inch 128x128 IPS LCD with GC9107 controller.
        SPI pins: SCLK=3, MOSI=2, DC=6, CS=5, RST=1, BL=10.
        Buttons: GPIO0 (BOOT) + GPIO47.

config SURVAIV_DISPLAY_GC9107_ATOMS3
    bool "M5Stack AtomS3 (128x128 GC9107)"
    help
        0.85 inch 128x128 IPS LCD with GC9107 controller.
        SPI pins: SCK=17, MOSI=21, DC=33, CS=15, RST=34, BL=16.
        Button: GPIO41 (programmable, under screen).

config SURVAIV_DISPLAY_ST7789_STICKC2
    bool "M5StickC PLUS2 (135x240 ST7789V2)"
    help
        1.14 inch 135x240 TFT LCD with ST7789V2 controller.
        SPI pins: CLK=13, MOSI=15, DC=14, CS=5, RST=12, BL=27.
        Buttons: A=GPIO37, B=GPIO39.

config SURVAIV_DISPLAY_SSD1306_C3OLED
    bool "ESP32-C3 SuperMini (72x40 SSD1306 OLED)"
    help
        0.42 inch 72x40 monochrome OLED with SSD1306 controller.
        I2C: SDA=5, SCL=6.  Button: GPIO9 (BOOT).
        Compact layout — shows equity, P&L, positions, and status.

endchoice

config SURVAIV_SCREEN_TIMEOUT_SEC
    int "Screen auto-off timeout (seconds)"
    depends on SURVAIV_HAS_DISPLAY
    range 5 300
    default 30
    help
        Turn off the backlight after this many seconds of inactivity.
        Any button press wakes the display.

endmenu

endmenu
```

## s3/sdkconfig.defaults
```kconfig
CONFIG_IDF_TARGET="esp32s3"
CONFIG_ESP_TLS_USING_MBEDTLS=y
CONFIG_MBEDTLS_CERTIFICATE_BUNDLE=y
CONFIG_MBEDTLS_CERTIFICATE_BUNDLE_DEFAULT_FULL=y
CONFIG_PARTITION_TABLE_CUSTOM=y
CONFIG_PARTITION_TABLE_CUSTOM_FILENAME="partitions.csv"
CONFIG_ESPTOOLPY_FLASHSIZE_16MB=y
CONFIG_ESP_MAIN_TASK_STACK_SIZE=32768
CONFIG_SPIRAM=y
CONFIG_SPIRAM_MODE_OCT=y
CONFIG_SPIRAM_SPEED_80M=y
CONFIG_SPIRAM_BOOT_INIT=y
CONFIG_SPIRAM_USE_CAPS_ALLOC=y
CONFIG_LWIP_DNS_SUPPORT_MDNS_QUERIES=y
```

## sdkconfig.defaults
```kconfig
CONFIG_ESP_TLS_USING_MBEDTLS=y
CONFIG_MBEDTLS_CERTIFICATE_BUNDLE=y
CONFIG_MBEDTLS_CERTIFICATE_BUNDLE_DEFAULT_FULL=y
CONFIG_PARTITION_TABLE_CUSTOM=y
CONFIG_PARTITION_TABLE_CUSTOM_FILENAME="partitions.csv"
CONFIG_ESPTOOLPY_FLASHSIZE_4MB=y
CONFIG_ESP_MAIN_TASK_STACK_SIZE=16384
```

## stickc2/sdkconfig.defaults.no_ota
```kconfig
# sdkconfig overlay: no-OTA build
# Apply with: idf.py -D SDKCONFIG_DEFAULTS="sdkconfig.defaults;sdkconfig.defaults.no_ota" build
CONFIG_SURVAIV_ENABLE_OTA=n
CONFIG_PARTITION_TABLE_CUSTOM=y
CONFIG_PARTITION_TABLE_CUSTOM_FILENAME="partitions_no_ota.csv"
```

## tqt/sdkconfig.defaults
```kconfig
CONFIG_IDF_TARGET="esp32s3"
CONFIG_ESP_TLS_USING_MBEDTLS=y
CONFIG_MBEDTLS_CERTIFICATE_BUNDLE=y
CONFIG_MBEDTLS_CERTIFICATE_BUNDLE_DEFAULT_FULL=y
CONFIG_PARTITION_TABLE_CUSTOM=y
CONFIG_PARTITION_TABLE_CUSTOM_FILENAME="partitions.csv"
CONFIG_ESPTOOLPY_FLASHSIZE_4MB=y
CONFIG_ESP_MAIN_TASK_STACK_SIZE=16384
CONFIG_SPIRAM=y
CONFIG_SPIRAM_MODE_QUAD=y
CONFIG_SPIRAM_SPEED_80M=y
CONFIG_SPIRAM_BOOT_INIT=y
CONFIG_SPIRAM_USE_MALLOC=y
CONFIG_SPIRAM_MALLOC_ALWAYSINTERNAL=16384
CONFIG_SPIRAM_MALLOC_RESERVE_INTERNAL=32768
CONFIG_LWIP_DNS_SUPPORT_MDNS_QUERIES=y
CONFIG_SURVAIV_HAS_DISPLAY=y
CONFIG_SURVAIV_DISPLAY_GC9107_TQT=y
CONFIG_SURVAIV_SCREEN_TIMEOUT_SEC=30
CONFIG_SURVAIV_MARKET_LIMIT=12
CONFIG_LWIP_MAX_SOCKETS=16
```
